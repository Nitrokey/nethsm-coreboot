## src/security/intel/acm/Kconfig
```kconfig
# SPDX-License-Identifier: GPL-2.0-only

config INTEL_ACM
	bool
	help
	  Select this to include ACMs.

if INTEL_ACM

config INTEL_BIOSACM_FILE
	string "BIOS ACM / S-ACM file"
	depends on INTEL_TXT || INTEL_CBNT_SUPPORT || INTEL_BG_SUPPORT
	default "3rdparty/blobs/soc/intel/skylake/biosacm.bin" if SOC_INTEL_COMMON_SKYLAKE_BASE
	help
	  Intel BIOS ACM or S-ACM file. This file can be obtained through privileged
	  access to Intel resources. Or for some platforms found inside the
	  blob repository.

config INTEL_SINITACM_FILE
	string "SINIT ACM file"
	depends on INTEL_TXT || INTEL_CBNT_SUPPORT
	default "3rdparty/blobs/soc/intel/skylake/sinitacm.bin" if SOC_INTEL_COMMON_SKYLAKE_BASE
	help
	  Intel TXT/CBnT SINIT ACM file. This file can be obtained through privileged
	  access to Intel resources. Or for some platforms found inside the
	  blob repository.

config INTEL_CBFS_BIOS_ACM
	string
	default "txt_bios_acm.bin" if INTEL_TXT
	default "cbnt_s_acm.bin" if INTEL_CBNT_SUPPORT
	default "bg_s_acm.bin" if INTEL_BG_SUPPORT

config INTEL_CBFS_SINIT_ACM
	string
	default "txt_sinit_acm.bin" if INTEL_TXT
	default "cbnt_sinit_acm.bin" if INTEL_CBNT_SUPPORT

config INTEL_BIOSACM_ALIGNMENT
	hex
	default 0x8000 if INTEL_BG_SUPPORT
	default 0x40000 if INTEL_CBNT_SUPPORT
	default 0x20000 # 128 KiB
	help
	  Exceptions are Ivy and Sandy Bridge with 64 KiB and Purley with 256 KiB
	  alignment size. If necessary, override from platform-specific Kconfig.

endif
```

## src/security/intel/bg/Kconfig
```kconfig
# SPDX-License-Identifier: GPL-2.0-only

config INTEL_BG_SUPPORT
	bool "Intel Boot Guard support"
	default n
	select INTEL_ACM
	depends on CPU_INTEL_FIRMWARE_INTERFACE_TABLE
	# With Boot Guard the bootblock is set up as a Boot Guard IBB and needs a fixed size
	help
	  Enables Intel Boot Guard Support. This will enable one to add a
	  Key Manifest (KM) and a Boot Policy Manifest (BPM) to the
	  filesystem. It will also wrap a FIT around the firmware and
	  update appropriate entries.

if INTEL_BG_SUPPORT

config INTEL_BG_GENERATE_KM
	bool "Generate Key Manifest (KM)"
	default y
	select INTEL_BG_NEED_KM_PUB_KEY
	select INTEL_BG_NEED_KM_PRIV_KEY if !INTEL_BG_KM_ONLY_UNSIGNED
	select INTEL_BG_NEED_BPM_PUB_KEY if !INTEL_BG_BG_PROV_KM_USE_CFG_FILE
	help
	  Select y to generate the Key Manifest (KM).
	  Select n to include a KM binary.

config INTEL_BG_KM_ONLY_UNSIGNED
	bool "Only unsigned key manifest (KM)"
	depends on INTEL_BG_GENERATE_KM
	help
	  Skip signing the KM.
	  The resulting unsigned KM will be placed at build/km_unsigned.bin.
	  The resulting coreboot image will not be functional with BG.
	  After the unsigned KM is signed externally you can either rebuild
	  coreboot using that binary or add it to CBFS and fit:
	  "$ cbfstool build/coreboot.rom add -f km.bin -n key_manifest.bin -t raw -a 16"
	  "$ ifittool -r COREBOOT -a -n key_manifest.bin -t 11 -s 12 -f build/coreboot.rom"
	  '-s 12' where 12 is CONFIG_CPU_INTEL_NUM_FIT_ENTRIES.

config INTEL_BG_BG_PROV_KM_USE_CFG_FILE
	bool "KM: use a BG json config file"
	depends on INTEL_BG_GENERATE_KM
	default y
	help
	  Select y to generate KM from a json config file.
	  Select n to generate KM from Kconfig options

config INTEL_BG_GENERATE_BPM
	bool
	default y
	select INTEL_BG_NEED_BPM_PRIV_KEY if !INTEL_BG_BPM_ONLY_UNSIGNED
	help
	  Select y to generate the Boot Policy Manifest (BPM).
	  Select n to include a BPM binary.

config INTEL_BG_BPM_ONLY_UNSIGNED
	bool "Only unsigned boot policy manifest (BPM)"
	depends on INTEL_BG_GENERATE_BPM
	help
	  Skip signing the BPM.
	  The resulting unsigned BPM will be placed at build/bpm_unsigned.bin.
	  The resulting coreboot image will not be functional with BG.
	  After the unsigned BPM is signed externally you can add it to cbfs
	  and fit:
	  "$ cbfstool build/coreboot.rom add -f bpm.bin -n boot_policy_manifest.bin -t raw -a 16"
	  "$ ifittool -r COREBOOT -a -n boot_policy_manifest.bin -t 12 -s 12 -f build/coreboot.rom"
	  '-s 12' where 12 is CONFIG_CPU_INTEL_NUM_FIT_ENTRIES.

config INTEL_BG_BG_PROV_BPM_USE_CFG_FILE
	bool "BPM: use a BG json config file"
	depends on INTEL_BG_GENERATE_BPM
	default y
	help
	  Select y to generate BPM from a json config file.
	  Select n to generate BPM from Kconfig options

config INTEL_BG_BG_PROV_CFG_FILE
	string "BG json config file"
	depends on INTEL_BG_BG_PROV_KM_USE_CFG_FILE || INTEL_BG_BG_PROV_BPM_USE_CFG_FILE
	help
	  Location of the bg-prov json config file.
	  Either get a sample JSON config file:
	  $ bg-prov template
	  Or extract it from a working configuration:
	  $ bg-prov read-config

config INTEL_BG_PROV_EXTERNAL_BIN
	bool "Use an external bg-prov binary"
	default n
	depends on INTEL_BG_GENERATE_BPM || INTEL_BG_GENERATE_KM
	help
	  Building bg-prov requires godeps which makes it impossible to build
	  it in an offline environment. A solution is to use an external binary.

config INTEL_BG_PROV_EXTERNAL_BIN_PATH
	string "bg-prov path"
	depends on INTEL_BG_PROV_EXTERNAL_BIN
	help
	  Path to the bg-prov binary.

config INTEL_BG_NEED_KM_PUB_KEY
	bool

config INTEL_BG_NEED_KM_PRIV_KEY
	bool

config INTEL_BG_KM_PUB_KEY_FILE
	string "Key manifest (KM) public key"
	depends on INTEL_BG_NEED_KM_PUB_KEY && !INTEL_BG_NEED_KM_PRIV_KEY
	help
	  Location of the key manifest (KM) public key file in .pem format.

config INTEL_BG_KM_PRIV_KEY_FILE
	string "Key manifest (KM) private key"
	depends on INTEL_BG_NEED_KM_PRIV_KEY
	help
	  Location of the key manifest (KM) private key file in .pem format.

config INTEL_BG_NEED_BPM_PUB_KEY
	bool

config INTEL_BG_NEED_BPM_PRIV_KEY
	bool

config INTEL_BG_BPM_PUB_KEY_FILE
	string "Boot policy manifest (BPM) public key"
	depends on INTEL_BG_NEED_BPM_PUB_KEY && !INTEL_BG_NEED_BPM_PRIV_KEY
	help
	  Location of the boot policy manifest (BPM) public key file in .pem format.

config INTEL_BG_BPM_PRIV_KEY_FILE
	string "Boot policy manifest (BPM) private key"
	depends on INTEL_BG_NEED_BPM_PRIV_KEY
	help
	  Location of the boot policy manifest (BPM) private key file in .pem format.


config INTEL_CPU_INTEL_FIT_POSITION_BG
	hex "FIT Position for CBFS"
	default 0xffff0000
	depends on INTEL_BG_SUPPORT
	help
	  Absolute position for FIT placement via CBFS. Boot Guard required this to be
	  at top of flash minus 4MB

if !INTEL_BG_BG_PROV_KM_USE_CFG_FILE && INTEL_BG_GENERATE_KM

menu "KM options"

config INTEL_BG_KM_VERSION
	int "KM version"
	default 1
	help
	  Version of the Key Manifest defined by the Platform Manufacturer.
	  The actual value is transparent to Boot Guard and is not processed by Boot Guard.

config INTEL_BG_KM_SVN
	int "KM security Version Number"
	range 0 15
	default 0
	help
	  This value is determined by the Platform Manufacturer.
	  Boot Guard uses this to compare it to the Key Manifest
	  Revocation Value (Revocation.KMSVN) in FPF.

	  If KMSVN < Revocation.KMSVN, the KM will be revoked. It will trigger ENF (the
	  enforcement policy).
	  IF KMSVN > Revocation.KMSVN, the Revocation.KMSVN will be set to the KMSVN.

	  Note: Once the value reaches 0Fh, revocation saturates and one can no longer
	  revoke newer KMs.

config INTEL_BG_KM_ID
	int "KM ID"
	range 1 15
	default 1
	help
	  This identifies the Key Manifest to be used for a platform.
	  This must match the Key Manifest Identifier programmed in
	  the field programmable fuses.

endmenu

endif # !INTEL_BG_BG_PROV_KM_USE_CFG_FILE

if !INTEL_BG_BG_PROV_BPM_USE_CFG_FILE && INTEL_BG_GENERATE_BPM
menu "BPM options"

config INTEL_BG_BPM_VERSION
	int "BPM version"
	default 1
	help
	  Version of the Key Manifest defined by the Platform Manufacturer.
	  The actual value is transparent to Boot Guard and is not processed by Boot Guard.

config INTEL_BG_BPM_SVN
	int "BPM Security Version Number"
	default 0
	help
	  This value is determined by the Platform Manufacturer.

config INTEL_BG_ACM_SVN
	int "S-ACM Security Version Number"
	default 2
	help
	  This defines the minimum version the S-ACM must have.

config INTEL_BG_PBET
	int "PBET value in s"
	default 15
	help
	  Protect BIOS Environment Timer (PBET) value.
	  Factor used by CSE to compute PBE timer value.
	  Actual PBE timer value is set by CSE using formula:
	  PBE timer value = 5 sec + PBETValue.

config INTEL_BG_IBB_FLAGS
	int "IBB flags"
	default 0
	help
	  IBB Control flags.
	  3: Don't extend PCR 0
	  7: extend PCR 7

config INTEL_BG_SINIT_SVN
	int "SINIT ACM security version number"
	default 0
	help
	  Minimum required version for the SINIT ACM.

config INTEL_BG_PD_INTERVAL
	int
	default 60
	help
	  Duration of Power Down in 5 sec increments.

endmenu

endif # !INTEL_BG_BG_PROV_BPM_USE_CFG_FILE

config INTEL_BG_KEY_MANIFEST_BINARY
	string "KM (Key Manifest) binary location"
	depends on !INTEL_BG_GENERATE_KM
	help
	  Location of the Key Manifest (KM)

endif # INTEL_BG_SUPPORT
```
